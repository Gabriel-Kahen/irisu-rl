## apps/web/guest/buildroot-external/configs/irisu_web_guest_defconfig
```kconfig
BR2_i386=y
BR2_x86_pentiumpro=y
BR2_REPRODUCIBLE=y
BR2_PRIMARY_SITE="https://sources.buildroot.net"
BR2_WGET="wget -4 -nd -t 1 -T 20"
BR2_GLOBAL_PATCH_DIR="$(BR2_EXTERNAL_IRISU_GUEST_PATH)/patches"
BR2_TARGET_GENERIC_HOSTNAME="irisu-web"
BR2_TARGET_GENERIC_ISSUE=""
BR2_INIT_BUSYBOX=y
BR2_TARGET_GENERIC_GETTY=y
BR2_TARGET_GENERIC_GETTY_PORT="ttyS0"
BR2_TARGET_GENERIC_GETTY_BAUDRATE_115200=y
BR2_TARGET_GENERIC_GETTY_TERM="vt100"
BR2_SYSTEM_DHCP=""
BR2_ROOTFS_OVERLAY="$(BR2_EXTERNAL_IRISU_GUEST_PATH)/board/irisu/rootfs-overlay"
BR2_PACKAGE_HOST_LINUX_HEADERS_CUSTOM_6_8=y
BR2_LINUX_KERNEL=y
BR2_LINUX_KERNEL_CUSTOM_VERSION=y
BR2_LINUX_KERNEL_CUSTOM_VERSION_VALUE="6.8.12"
BR2_LINUX_KERNEL_USE_CUSTOM_CONFIG=y
BR2_LINUX_KERNEL_CUSTOM_CONFIG_FILE="$(BR2_EXTERNAL_IRISU_GUEST_PATH)/board/irisu/linux.config"
BR2_TARGET_ROOTFS_INITRAMFS=y
BR2_TARGET_ROOTFS_CPIO_GZIP=y
# BR2_TARGET_ROOTFS_TAR is not set
```
